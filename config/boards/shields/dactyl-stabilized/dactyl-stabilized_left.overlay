/*
 * Copyright (c) 2020 Ryan Cross, Bruce Jones
 *
 * SPDX-License-Identifier: MIT
 */

#include "dactyl-stabilized.dtsi"

&kscan0 {
	col-gpios
		= <&pro_micro_a 6 GPIO_ACTIVE_HIGH>
		, <&pro_micro_a 8 GPIO_ACTIVE_HIGH>
		, <&pro_micro_a 17 GPIO_ACTIVE_HIGH>
		, <&pro_micro_d 20 GPIO_ACTIVE_HIGH>
		, <&pro_micro_d 22 GPIO_ACTIVE_HIGH>
		, <&pro_micro_d 24 GPIO_ACTIVE_HIGH>
		, <&pro_micro_d 00 GPIO_ACTIVE_HIGH>
		;
};
