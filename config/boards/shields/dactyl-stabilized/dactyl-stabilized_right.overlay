/*
 * Copyright (c) 2020 Ryan Cross, Bruce Jones
 *
 * SPDX-License-Identifier: MIT
 */

#include "dactyl-stabilized.dtsi"

&default_transform {
	col-offset = <7>;
};

&kscan0 {
	col-gpios
		= <&gpio1 0 GPIO_ACTIVE_HIGH>
		, <&gpio0 24 GPIO_ACTIVE_HIGH>
		, <&gpio0 22 GPIO_ACTIVE_HIGH>
		, <&gpio0 20 GPIO_ACTIVE_HIGH>
		, <&gpio0 17 GPIO_ACTIVE_HIGH>
		, <&gpio0 8 GPIO_ACTIVE_HIGH>
		, <&gpio0 6 GPIO_ACTIVE_HIGH>
		;
};
